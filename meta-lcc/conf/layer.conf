## meta-lcc/conf/layer.conf
```bitbake
# Layer configuration for meta-lcc.

BBPATH .= ":${LAYERDIR}"
BBFILES += "${LAYERDIR}/recipes-*/*/*.bb ${LAYERDIR}/recipes-*/*/*.bbappend"

BBFILE_COLLECTIONS += "lcc"
BBFILE_PATTERN_lcc = "^${LAYERDIR}/"
BBFILE_PRIORITY_lcc = "6"

LAYERDEPENDS_lcc = "core"

# Only the series this layer has been built with.
LAYERSERIES_COMPAT_lcc = "blacksail"
```
